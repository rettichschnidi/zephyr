## boards/arm/gardena_nrf52840_smart_gateway/Kconfig
```kconfig
# Kconfig - Gardena nRF52840 Smart Gateway board configuration
#
# Copyright (c) 2016 Nordic Semiconductor ASA
#
# SPDX-License-Identifier: Apache-2.0

if BOARD_GARDENA_NRF52840_SMART_GATEWAY

config BOARD_ENABLE_DCDC
        bool "Enable DCDC mode"
        select SOC_DCDC_NRF52X
        default y

endif # BOARD_GARDENA_NRF52840_SMART_GATEWAY
```

## boards/arm/gardena_nrf52840_smart_gateway/Kconfig.board
```kconfig
# Kconfig - Gardena nRF52840 Smart Gateway board configuration
#
# Copyright (c) 2018, Reto Schneider <code@reto-schneider.ch>
#
# SPDX-License-Identifier: Apache-2.0

config  BOARD_GARDENA_NRF52840_SMART_GATEWAY
	bool "GARDENA NRF52840 SMART GATEWAY"
	depends on SOC_NRF52840_QIAA
```

## boards/arm/gardena_nrf52840_smart_gateway/Kconfig.defconfig
```kconfig
# Kconfig - nRF52 PCA10040 board configuration
#
# Copyright (c) 2016 Nordic Semiconductor ASA
#
# SPDX-License-Identifier: Apache-2.0

if BOARD_GARDENA_NRF52840_SMART_GATEWAY

config BOARD
	default "gardena_nrf52840_smart_gateway"

if USB

config USB_NRF52840
	def_bool y

config USB_DEVICE_STACK
	def_bool y

endif # USB

if IEEE802154

config IEEE802154_NRF5
	def_bool y

endif # IEEE802154

endif # BOARD_GARDENA_NRF52840_SMART_GATEWAY
```

## boards/arm/gardena_sgrmt1/Kconfig
```kconfig
# Kconfig - GARDENA SGRMT1 board configuration
#
# Copyright (c) 2019 Reto Schneider
#
# SPDX-License-Identifier: Apache-2.0

if BOARD_GARDENA_SGRMT1

config BOARD_INIT_PRIORITY
	int

	# omit prompt to signify a "hidden" option
	default KERNEL_INIT_PRIORITY_DEFAULT
	help
	  Board initialization priority. This must be bigger than
	  GPIO_SIM3_COMMON_INIT_PRIORITY.

endif # BOARD_GARDENA_SGRMT1
```

## boards/arm/gardena_sgrmt1/Kconfig.board
```kconfig
# Kconfig - GARDENA SGRMT1 board
#
# Copyright (c) 2019 Reto Schneider
#
# SPDX-License-Identifier: Apache-2.0
#

config BOARD_GARDENA_SGRMT1
	bool "GARDENA SGRMT1"
	depends on SOC_SERIES_SIM3U
	select SOC_PART_NUMBER_SIM3U167_A_GM
```

## boards/arm/gardena_sgrmt1/Kconfig.defconfig
```kconfig
# Kconfig - GARDENA SGRMT1 board
#
# Copyright (c) 2019 Reto Schneider
#
# SPDX-License-Identifier: Apache-2.0
#

if BOARD_GARDENA_SGRMT1

config BOARD
default "GARDENA_SGRMT1"

endif # BOARD_GARDENA_SGRMT1
```

## boards/arm/gardena_sgrmt1/gardena_sgrmt1_defconfig
```kconfig
CONFIG_ARM=y
CONFIG_SOC_FAMILY_SIM3=y
CONFIG_SOC_SERIES_SIM3U=y
CONFIG_BOARD_GARDENA_SGRMT1=y
CONFIG_CORTEX_M_SYSTICK=y
CONFIG_SYS_CLOCK_HW_CYCLES_PER_SEC=20000000
CONFIG_GPIO=y
CONFIG_SOC_SERIES_SIM3U_CROSSBAR_1_PB2_0_SKIP=y
CONFIG_SOC_SERIES_SIM3U_CROSSBAR_1_PB2_1_SKIP=y
CONFIG_GPIO_SIM3_PBSTD=y
CONFIG_GPIO_SIM3_PORT2=y
CONFIG_GPIO_SIM3_PBHD=y
CONFIG_GPIO_SIM3_PORT4=y
CONFIG_CONSOLE=y
CONFIG_SERIAL=y
```

## boards/arm/gardena_smart_radio_module/Kconfig
```kconfig
# Kconfig - Gardena smart Radio Module configuration
#
# Copyright (c) 2017 Christian Taedcke
#
# SPDX-License-Identifier: Apache-2.0

if BOARD_GARDENA_SMART_RADIO_MODULE

config BOARD_INIT_PRIORITY
	int

	# omit prompt to signify a "hidden" option
	default KERNEL_INIT_PRIORITY_DEFAULT
	depends on GPIO
	help
	  Board initialization priority. This must be bigger than
	  GPIO_PRECISION32_COMMON_INIT_PRIORITY.

endif # BOARD_GARDENA_SMART_RADIO_MODULE
```

## boards/arm/gardena_smart_radio_module/Kconfig.board
```kconfig
# Kconfig - Gardena smart Radio Module
#
# Copyright (c) 2017, Christian Taedcke
#
# SPDX-License-Identifier: Apache-2.0
#

config BOARD_GARDENA_SMART_RADIO_MODULE
	bool "Gardena smart Radio Module"
	depends on SOC_SERIES_SIM3U
	select SOC_PART_NUMBER_SIM3U167
```

## boards/arm/gardena_smart_radio_module/Kconfig.defconfig
```kconfig
# Kconfig - Gardena smart Radio Module
#
# Copyright (c) 2017, Christian Taedcke
#
# SPDX-License-Identifier: Apache-2.0
#

if BOARD_GARDENA_SMART_RADIO_MODULE

config BOARD
	default "gardena_smart_radio_module"

if GPIO_PRECISION32

config GPIO_PRECISION32_PORTBANK0
	def_bool y

config GPIO_PRECISION32_PORTBANK1
	def_bool y

config GPIO_PRECISION32_PORTBANK2
	def_bool y

config GPIO_PRECISION32_PORTBANK3
	def_bool y

config GPIO_PRECISION32_PORTBANK4
	def_bool y

endif # GPIO_PRECISION32

if UART_PRECISION32

config UART_PRECISION32_0
	def_bool y

config UART_PRECISION32_0_GPIO_LOC
	default 0

endif # UART_PRECISION32

endif # BOARD_GARDENA_SMART_RADIO_MODULE
```

## drivers/gpio/Kconfig.precision32
```kconfig
# Kconfig.precision32 - Precision32 GPIO configuration options
#
# Copyright (c) 2018 Reto Schneider <code@reto-schneider.ch>
#
# SPDX-License-Identifier: Apache-2.0
#

menuconfig GPIO_PRECISION32
	bool "Precision32 GPIO driver"
	depends on GPIO && HAS_SILABS_PRECISION32
	help
	  Enable the Precision32 gpio driver.

if GPIO_PRECISION32

config GPIO_PRECISION32_COMMON_NAME
	string "Common driver name"
	default "GPIO_COMMON"

config GPIO_PRECISION32_COMMON_INIT_PRIORITY
	int "Common initialization priority"
	default 39

config GPIO_PRECISION32_COMMON_PRI
	int "Interrupt priority"
	default 2

config GPIO_PRECISION32_PORTBANK0
	bool "Port Bank 1ank 0"
	help
	  Enable Port Bank 1ank 0.

config GPIO_PRECISION32_PORTBANK0_NAME
	string "Port Bank 1ank 0 driver name"
	depends on GPIO_PRECISION32_PORTBANK0
	default "GPIO_0"

config GPIO_PRECISION32_PORTBANK1
	bool "Port Bank 1"
	help
	  Enable Port Bank 1.

config GPIO_PRECISION32_PORTBANK1_NAME
	string "Port Bank 1 driver name"
	depends on GPIO_PRECISION32_PORTBANK1
	default "GPIO_1"

config GPIO_PRECISION32_PORTBANK2
	bool "Port Bank 2"
	help
	  Enable Port Bank 2.

config GPIO_PRECISION32_PORTBANK2_NAME
	string "Port Bank 2 driver name"
	depends on GPIO_PRECISION32_PORTBANK2
	default "GPIO_2"

config GPIO_PRECISION32_PORTBANK3
	bool "Port Bank 3"
	help
	  Enable Port Bank 3.

config GPIO_PRECISION32_PORTBANK3_NAME
	string "Port Bank 3 driver name"
	depends on GPIO_PRECISION32_PORTBANK3
	default "GPIO_3"

config GPIO_PRECISION32_PORTBANK4
	bool "Port Bank 4"
	help
	  Enable Port Bank 4.

config GPIO_PRECISION32_PORTBANK4_NAME
	string "Port Bank 4 driver name"
	depends on GPIO_PRECISION32_PORTBANK4
	default "GPIO_4"

endif # GPIO_PRECISION32
```

## drivers/gpio/Kconfig.sim3
```kconfig
# Kconfig.sim3 - Sim3 GPIO configuration options
#
# Copyright (c) 2019 Christian Taedcke
#
# SPDX-License-Identifier: Apache-2.0
#

menuconfig GPIO_SIM3
	bool "SiM3 GPIO driver"
	depends on GPIO && SOC_FAMILY_SIM3
	select HAS_DTS_GPIO
	help
	  Enable the SiM3 gpio driver.

if GPIO_SIM3

config GPIO_SIM3_PBSTD_COMMON_INIT_PRIORITY
	int "Common initialization priority"
	default 39

menuconfig GPIO_SIM3_PBSTD
	bool "SiM3 PBSTD GPIO driver"
	depends on GPIO_SIM3
	help
	  Enable the SiM3 Port Bank Standard gpio driver.

if GPIO_SIM3_PBSTD

config GPIO_SIM3_PORT0
	bool "Port 0"
	depends on GPIO_SIM3_PBSTD
	help
	  Enable Port Bank PB0.

config GPIO_SIM3_PORT1
	bool "Port 1"
	depends on GPIO_SIM3_PBSTD
	help
	  Enable Port Bank PB1.

config GPIO_SIM3_PORT2
	bool "Port 2"
	depends on GPIO_SIM3_PBSTD
	help
	  Enable Port Bank PB2.

config GPIO_SIM3_PORT3
	bool "Port 3"
	depends on GPIO_SIM3_PBSTD
	help
	  Enable Port Bank PB3.

endif # GPIO_SIM3_PBSTD

menuconfig GPIO_SIM3_PBHD
	bool "SiM3 PBHD GPIO driver"
	depends on GPIO_SIM3
	help
	  Enable the SiM3 High Drive Port Bank gpio driver.

if GPIO_SIM3_PBHD

config GPIO_SIM3_PORT4
	bool "Port 4"
	help
	  Enable Port Bank PB4.

endif # GPIO_SIM3_PBHD

endif # GPIO_SIM3
```

## drivers/ieee802154/Kconfig.si4467
```kconfig
# Silicon Labs Si4467 802.15.4 configuration options

# Copyright (c) 2020 Reto Schneider
# SPDX-License-Identifier: Apache-2.0

menuconfig IEEE802154_SI4467
    bool "Silicon Labs 4467 IEEE 802.15.4 Driver"
    depends on NETWORKING && SPI
    select SPI
    select GPIO

if IEEE802154_SI4467

config IEEE802154_SI4467_DRV_NAME
    string "Silicon Labs 4467 IEEE 802.15.4 Driver's name"
    default "IEEE802154_si4467"
    help
      This option sets the driver name

config IEEE802154_SI4467_RX_STACK_SIZE
    int "Driver's internal RX thread stack size"
    default 800
    help
      This option sets the driver's stack size for its internal RX thread.
      The default value should be sufficient, but in case it proves to be
      a too little one, this option makes it easy to play with the size.

config IEEE802154_SI4467_INIT_PRIO
    int "Silicon Labs 4467 IEEE 802.15.4 initialization priority"
    default 80
    help
      Set the initialization priority number. Do not mess with it unless
      you know what you are doing. Beware si4467 requires gpio and spi to
      be ready first (and sometime gpio should be the very first as spi
      might need it too). And of course it has to start before the net stack.

endif
```

## drivers/serial/Kconfig.precision32
```kconfig
# Kconfig - Precision32 SDK UART
#
# Copyright (c) 2017, Christian Taedcke
#
# SPDX-License-Identifier: Apache-2.0
#

menuconfig UART_PRECISION32
	bool "Precision32 uart driver"
	depends on HAS_SILABS_PRECISION32
	depends on GPIO_PRECISION32
	select SERIAL_HAS_DRIVER
	help
	  Enable the Precision32 uart driver.

if UART_PRECISION32

menuconfig UART_PRECISION32_0
	bool "UART 0"
	help
	  Enable UART 0.

if UART_PRECISION32_0

config UART_PRECISION32_0_GPIO_LOC
	int "Pin Locations"
	range 0 3
	depends on UART_PRECISION32
	help
	  The GPIO pins to use.

endif # UART_PRECISION32_0

menuconfig UART_PRECISION32_1
	bool "UART 1"
	help
	  Enable UART 1.

if UART_PRECISION32_1

config UART_PRECISION32_1_GPIO_LOC
	int "Pin Locations"
	range 0 3
	depends on UART_PRECISION32
	help
	  The GPIO pins to use.

endif # UART_PRECISION32_1

menuconfig USART_PRECISION32_0
	bool "USART 0"
	help
	  Enable USART 0.

if USART_PRECISION32_0

config USART_PRECISION32_0_GPIO_LOC
	int "Pin Locations"
	range 0 3
	depends on UART_PRECISION32
	help
	  The GPIO pins to use.

endif # USART_PRECISION32_0

menuconfig USART_PRECISION32_1
	bool "USART 1"
	help
	  Enable USART 1.

if USART_PRECISION32_1

config USART_PRECISION32_1_GPIO_LOC
	int "Pin Locations"
	range 0 3
	depends on UART_PRECISION32
	help
	  The GPIO pins to use.

endif # USART_PRECISION32_1

endif # UART_PRECISION32
```

## drivers/serial/Kconfig.sim3
```kconfig
# Kconfig - SiM3 UART
#
# Copyright (c) 2019, Christian Taedcke
#
# SPDX-License-Identifier: Apache-2.0
#

menuconfig UART_SIM3
	bool "SiM3 UART/USART driver"
	depends on SOC_FAMILY_SIM3
	depends on GPIO_SIM3
	depends on (SOC_SERIES_SIM3U_CROSSBAR_0 || SOC_SERIES_SIM3U_CROSSBAR_1)
	select SERIAL_HAS_DRIVER
	select SERIAL_SUPPORT_INTERRUPT
	select SOC_SIM3_USART
	help
	  Enable the SiM3 uart driver.

if UART_SIM3

config UART_SIM3_0
	bool "Enable SiM3 UART 0"
	help
	  Enable support for SiM3 UART0 port in the driver. Say y here if you
	  want to use UART0 device.

config UART_SIM3_1
	bool "Enable SiM3 UART 1"
	help
	  Enable support for SiM3 UART1 port in the driver. Say y here if you
	  want to use UART1 device.

config USART_SIM3_0
	bool "Enable SiM3 USART 0"
	help
	  Enable support for SiM3 USART0 port in the driver. Say y here if you
	  want to use USART0 device.

config USART_SIM3_1
	bool "Enable SiM3 USART 1"
	help
	  Enable support for SiM3 USART1 port in the driver. Say y here if you
	  want to use USART1 device.

endif # UART_SIM3
```

## dts/bindings/gpio/silabs,sim3-gpio-port.yaml
```yaml
---
title: SIM3 GPIO
compatible: "silabs,sim3-gpio-port"

description: >
    This is a representation of the SIM3 GPIO Port nodes

include: [gpio-controller.yaml, base.yaml]

properties:
    compatible:
      required: true
      description: compatible strings

    reg:
      description: mmio register space
      required: true

    label:
      type: string
      required: true
      description: Human readable string describing the device (used by Zephyr for API name)

"#cells":
  - pin
  - flags
...
```

## dts/bindings/gpio/silabs,sim3-gpio.yaml
```yaml
---
title: SIM3 GPIO
compatible: "silabs,sim3-gpio"

description: >
    This is a representation of the SIM3 GPIO nodes

include: base.yaml

properties:
    compatible:
      required: true
      description: compatible strings

    reg:
      type: array
      description: mmio register space
      required: true

    interrupts:
      required: true
      description: required interrupts

    label:
      type: string
      required: true
      description: Human readable string describing the device (used by Zephyr for API name)

...
```

## dts/bindings/serial/silabs,precision32-uart.yaml
```yaml
---
title: PRECISION32 UART
id: silabs,precision32-uart
version: 0.1

description: >
    This binding gives a base representation of the Precision32 UART

inherits:
    !include uart.yaml

properties:
    compatible:
      constraint: "silabs,precision32-uart"

    reg:
      type: array
      description: mmio register space
      generation: define
      category: required

    interrupts:
      type: array
      category: required
      description: required interrupts
      generation: define
...
```

## dts/bindings/serial/silabs,sim3-uart.yaml
```yaml
---
title: SIM3 UART
compatible: "silabs,sim3-uart"

description: >
    This binding gives a base representation of the SIM3 UART

include: uart-controller.yaml

properties:
    reg:
      required: true

    interrupts:
      required: true

...
```

## ext/hal/silabs/precision32/Kconfig
```kconfig
# Kconfig - Precision32 SDK
#
# Copyright (c) 2018, Reto Schneider
#
# SPDX-License-Identifier: Apache-2.0
#

config HAS_SILABS_PRECISION32
	bool
	select HAS_CMSIS
	depends on SOC_FAMILY_PRECISION32
```

## soc/arm/silabs_precision32/Kconfig
```kconfig
#
# Copyright (c) 2017 Christian Taedcke
#
# SPDX-License-Identifier: Apache-2.0
#

config SOC_FAMILY_PRECISION32
	bool
	# omit prompt to signify a "hidden" option

if SOC_FAMILY_PRECISION32
config SOC_FAMILY
	string
	default "silabs_precision32"

source "soc/arm/silabs_precision32/*/Kconfig.soc"

config SOC_PART_NUMBER
	string
	default SOC_PART_NUMBER_PRECISION32_SIM3U167 if SOC_SERIES_SIM3U
	help
	  This string holds the full part number of the SoC. It is a hidden option
	  that you should not set directly. The part number selection choice defines
	  the default value for this string.

endif # SOC_FAMILY_PRECISION32
```

## soc/arm/silabs_precision32/Kconfig.soc
```kconfig
#
# Copyright (c) 2017 Christian Taedcke
#
# SPDX-License-Identifier: Apache-2.0
#

source "soc/arm/silabs_precision32/*/Kconfig.series"
```

## soc/arm/silabs_precision32/sim3u/Kconfig.defconfig.series
```kconfig
# Kconfig - SIM3U series configuration options

#
# Copyright (c) 2017 Christian Taedcke
#
# SPDX-License-Identifier: Apache-2.0
#

if SOC_SERIES_SIM3U

config SOC_SERIES
	default "sim3u"

config NUM_IRQS
	int
	# must be >= the highest interrupt number used
	default 53

source "soc/arm/silabs_precision32/sim3u/Kconfig.defconfig.sim3*"

endif # SOC_SERIES_SIM3U
```

## soc/arm/silabs_precision32/sim3u/Kconfig.defconfig.sim3u
```kconfig
# Kconfig - Silicon Labs SIM3U-STK3800 platform configuration options

#
# Copyright (c) 2017 Christian Taedcke
#
# SPDX-License-Identifier: Apache-2.0
#

if SOC_SIM3U

config SOC
	string
	default "sim3u"

if GPIO

config GPIO_PRECISION32
	def_bool y

endif # GPIO

if SERIAL

config UART_PRECISION32
	def_bool y

endif # SERIAL

endif # SOC_SIM3U
```

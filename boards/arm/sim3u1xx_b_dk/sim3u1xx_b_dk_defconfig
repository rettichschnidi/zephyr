## boards/arm/sim3u1xx_b_dk/sim3u1xx_b_dk_defconfig
```kconfig
CONFIG_SOC_SERIES_SIM3U=y
CONFIG_SYS_CLOCK_HW_CYCLES_PER_SEC=20000000

# Enable all supported hardware
CONFIG_SERIAL=y
CONFIG_GPIO=y
CONFIG_FLASH=y

# Put UART0 RX/TX on PB1.12/PB1.13
CONFIG_SOC_SERIES_SIM3U_CROSSBAR_0_PB0_0_SKIP=y
CONFIG_SOC_SERIES_SIM3U_CROSSBAR_0_PB0_1_SKIP=y
CONFIG_SOC_SERIES_SIM3U_CROSSBAR_0_PB0_2_SKIP=y
CONFIG_SOC_SERIES_SIM3U_CROSSBAR_0_PB0_3_SKIP=y
CONFIG_SOC_SERIES_SIM3U_CROSSBAR_0_PB0_4_SKIP=y
CONFIG_SOC_SERIES_SIM3U_CROSSBAR_0_PB0_5_SKIP=y
CONFIG_SOC_SERIES_SIM3U_CROSSBAR_0_PB0_6_SKIP=y
CONFIG_SOC_SERIES_SIM3U_CROSSBAR_0_PB0_7_SKIP=y
CONFIG_SOC_SERIES_SIM3U_CROSSBAR_0_PB0_8_SKIP=y
CONFIG_SOC_SERIES_SIM3U_CROSSBAR_0_PB0_9_SKIP=y
CONFIG_SOC_SERIES_SIM3U_CROSSBAR_0_PB0_10_SKIP=y
CONFIG_SOC_SERIES_SIM3U_CROSSBAR_0_PB0_11_SKIP=y
CONFIG_SOC_SERIES_SIM3U_CROSSBAR_0_PB0_12_SKIP=y
CONFIG_SOC_SERIES_SIM3U_CROSSBAR_0_PB0_13_SKIP=y
CONFIG_SOC_SERIES_SIM3U_CROSSBAR_0_PB0_14_SKIP=y
CONFIG_SOC_SERIES_SIM3U_CROSSBAR_0_PB0_15_SKIP=y
CONFIG_SOC_SERIES_SIM3U_CROSSBAR_0_PB1_0_SKIP=y
CONFIG_SOC_SERIES_SIM3U_CROSSBAR_0_PB1_1_SKIP=y
CONFIG_SOC_SERIES_SIM3U_CROSSBAR_0_PB1_2_SKIP=y
CONFIG_SOC_SERIES_SIM3U_CROSSBAR_0_PB1_3_SKIP=y
CONFIG_SOC_SERIES_SIM3U_CROSSBAR_0_PB1_4_SKIP=y
CONFIG_SOC_SERIES_SIM3U_CROSSBAR_0_PB1_5_SKIP=y
CONFIG_SOC_SERIES_SIM3U_CROSSBAR_0_PB1_6_SKIP=y
CONFIG_SOC_SERIES_SIM3U_CROSSBAR_0_PB1_7_SKIP=y
CONFIG_SOC_SERIES_SIM3U_CROSSBAR_0_PB1_8_SKIP=y
CONFIG_SOC_SERIES_SIM3U_CROSSBAR_0_PB1_9_SKIP=y
CONFIG_SOC_SERIES_SIM3U_CROSSBAR_0_PB1_10_SKIP=y
CONFIG_SOC_SERIES_SIM3U_CROSSBAR_0_PB1_11_SKIP=y

# Simplifying debugging
CONFIG_SHELL=y
```

## boards/gardena/aqua_precise/Kconfig.aqua_precise
```kconfig
# Copyright (c) 2026 GARDENA GmbH
#
# SPDX-License-Identifier: Apache-2.0

config BOARD_AQUA_PRECISE
        select SOC_NRF52840_QIAA
```

## boards/gardena/aqua_precise/board.yml
```yaml
# Copyright (c) 2026 Reto Schneider
#
# SPDX-License-Identifier: Apache-2.0

board:
  name: aqua_precise
  full_name: AquaPrecise
  vendor: gardena
  socs:
    - name: nrf52840
```

## boards/gardena/rm_sim3u/Kconfig.defconfig
```kconfig
# Copyright (c) 2023 GARDENA GmbH
#
# SPDX-License-Identifier: Apache-2.0

if BOARD_RM_SIM3U

config BOARD
	default "rm_sim3u"

endif # BOARD_RM_SIM3U
```

## drivers/display/Kconfig.st77916
```kconfig
# Copyright (c) 2026 Siemens
# SPDX-License-Identifier: Apache-2.0

config ST77916
	bool "ST77916 display driver"
	default y
	depends on DT_HAS_SITRONIX_ST77916_ENABLED
	select MIPI_DBI
	help
	  Enable driver for ST77916 display controller.
```

## drivers/flash/Kconfig.sim3
```kconfig
# Kconfig - Silicon Labs SiM3 flash driver config
#
# Copyright (c) 2019, Christian Taedcke
#
# SPDX-License-Identifier: Apache-2.0

config SOC_FLASH_SIM3
	bool "Silicon Labs Sim3 flash driver"
	depends on FLASH && SOC_FAMILY_SIM3
	select FLASH_HAS_DRIVER_ENABLED
	select FLASH_PAGE_LAYOUT
	select FLASH_HAS_PAGE_LAYOUT
	help
	  Enable Silicon Labs Sim3 series internal flash driver.
```

## drivers/stepper/gpio_stepper/Kconfig.gpio_stepper_driver
```kconfig
# SPDX-FileCopyrightText: Copyright (c) 2026 Reto Schneider
# SPDX-License-Identifier: Apache-2.0

config STEPPER_GPIO_STEPPER_DRIVER
	bool "Activate driver for plain GPIO stepper enable/disable"
	depends on DT_HAS_ZEPHYR_GPIO_STEPPER_DRIVER_ENABLED
	default y
```

## dts/bindings/stepper/zephyr,gpio-stepper-driver.yaml
```yaml
# SPDX-FileCopyrightText: Copyright (c) 2026 Reto Schneider
# SPDX-License-Identifier: Apache-2.0

description: |
  Plain GPIO stepper hardware driver.

  Used to enable/disable a stepper motor power stage (e.g. a darlington transistor array or
  H-bridge) that has no dedicated driver IC and is instead controlled directly via GPIOs by a
  motion controller such as zephyr,h-bridge-stepper-ctrl.

compatible: "zephyr,gpio-stepper-driver"

include: stepper-driver.yaml

properties:
  en-gpios:
    required: true

examples:
  - |
    gpio_stepper_driver: gpio-stepper-driver {
        compatible = "zephyr,gpio-stepper-driver";
        en-gpios = <&gpioa 6 GPIO_ACTIVE_HIGH>;
    };
```

## soc/silabs/silabs_sim3/Kconfig.defconfig
```kconfig
# Copyright (c) 2023 GARDENA GmbH
#
# SPDX-License-Identifier: Apache-2.0

source "soc/silabs/silabs_sim3/*/Kconfig.defconfig.series"
```

## soc/silabs/silabs_sim3/Kconfig.soc
```kconfig
# Copyright (c) 2023 GARDENA GmbH
#
# SPDX-License-Identifier: Apache-2.0

config SOC_FAMILY_SILABS_SIM3
	bool

rsource "*/Kconfig.soc"
```

## soc/silabs/silabs_sim3/sim3u/Kconfig.soc
```kconfig
# Copyright (c) 2023 GARDENA GmbH
#
# SPDX-License-Identifier: Apache-2.0

config SOC_SERIES_SIM3U
	bool
	select SOC_FAMILY_SILABS_SIM3
	help
	  SiM3U series MCU

config SOC_PART_NUMBER_SIM3U167BGM
	bool
	select SOC_SERIES_SIM3U

config SOC_SERIES
	default "sim3u" if SOC_SERIES_SIM3U

config SOC
	default "sim3u167bgm" if SOC_PART_NUMBER_SIM3U167BGM

config SOC_PART_NUMBER
	default "SiM3U167BGM" if SOC_PART_NUMBER_SIM3U167BGM
```
